## subsys/trusted_firmware_m/Kconfig
```kconfig
#
# Copyright (c) 2019 Nordic Semiconductor ASA
#
# SPDX-License-Identifier: LicenseRef-BSD-5-Clause-Nordic
#

menu "Trusted Firmware M"

menuconfig TFM
	bool "Add TF-M secure firmware image"
	#default y if TRUSTED_EXECUTION_NONSECURE


# Define used by partition_manager.py to deduce size of partition.
# Unable to use the size template due to non-trivial defaults.
config PM_PARTITION_SIZE_TFM
	hex "Flash space reserved for TF-M"
	default 0x20000
	help
	  Flash space set aside for the TF-M. Note, the name
	  of this configuration needs to match the requirements set by the
	  script 'partition_manager.py'. See pm.yml.

config TFM_CRYPTO
	bool "Enable the Crypto service"
	help
	  Enable TFM_PARTITION_CRYPTO.

# Set new default name for the veneers file.
#if ARM_FIRMWARE_USES_SECURE_ENTRY_FUNCS
#config ARM_ENTRY_VENEERS_LIB_NAME
#	string "Entry Veneers symbol file"
#	default "tfm/s_veneers.a"
#endif

if TFM
module=TFM
source "${ZEPHYR_BASE}/../nrf/subsys/partition_manager/Kconfig.template.build_strategy"
endif

endmenu # TFM
```

## tests/subsys/bootloader/bl_validation_ff_key/testcase.yaml
```yaml
tests:
  bootloader.bl_validation.ff_key:
    platform_whitelist: nrf5340pdk_nrf5340_cpuapp nrf9160dk_nrf9160 nrf52840dk_nrf52840 nrf52dk_nrf52832
    tags: b0 bl_validation ff_key
    harness: console
    harness_config:
      type: multi_line
      ordered: true
      regex:
        - "A public key is 0xFFFF, which is unsupported"
        - "Firmware validation failed with error -113."
        - "Failed to validate, permanently invalidating!"
        - "No bootable image found. Aborting boot."
```
