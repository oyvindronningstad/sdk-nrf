## prj.conf
```kconfig
#
# Copyright (c) 2018 Nordic Semiconductor ASA
#
# SPDX-License-Identifier: LicenseRef-BSD-5-Clause-Nordic
#

CONFIG_ZTEST=y
CONFIG_SECURE_BOOT=y
CONFIG_FW_INFO=y
CONFIG_SECURE_BOOT_CRYPTO=y
CONFIG_SECURE_BOOT_VALIDATION=y
CONFIG_NRFX_NVMC=y
CONFIG_MPU_ALLOW_FLASH_WRITE=y
CONFIG_REBOOT=y
CONFIG_SECURE_BOOT_STORAGE=y
```

## src/main.c
```c
/*
 * Copyright (c) 2018 Nordic Semiconductor ASA
 *
 * SPDX-License-Identifier: LicenseRef-BSD-5-Clause-Nordic
 */

#include <ztest.h>
// #include <bl_validation.h>
#include <fw_info.h>
#include <pm_config.h>
// #include <sys/util.h>
#include <nrfx_nvmc.h>
#include <linker/linker-defs.h>
// #include <devicetree.h>
#include <power/reboot.h>
#include <bl_storage.h>
#include <fw_info.h>



/* These symbols are defined in linker scripts. */
// extern const u32_t _flash_used[];
// extern const struct fw_info _firmware_info_start[];
extern const u32_t _ext_apis_size[];
extern const u32_t _ext_apis_req_size[];
// extern const u32_t _fw_info_images_start[];
// extern const u32_t _fw_info_images_size[];
// extern const u32_t _fw_info_size[];

extern const struct fw_info m_firmware_info;

u32_t val_info_buf[0x1000];

void test_validation_neg1(void)
{
	u32_t copy_len = (u32_t)_flash_used;

	/* Round up to at least the next SPU region. */
	u32_t new_addr = ROUND_UP(PM_ADDRESS + (PM_SIZE / 2), 0x8000);

	const struct fw_info s1_info = {
		.magic = {FIRMWARE_INFO_MAGIC},
		.total_size = PM_S0_ADDRESS - PM_S1_ADDRESS,
		.size = ((u32_t)_flash_used),
		.version = CONFIG_FW_INFO_FIRMWARE_VERSION + 1,
		.address = new_addr,
		.boot_address = new_addr,
		.valid = CONFIG_FW_INFO_VALID_VAL,
		.reserved = {0, 0, 0, 0},
		.ext_api_num = 0,
		.ext_api_request_num = 0,
	};

	const struct fw_info *s1_info_copied = fw_info_find(PM_S1_ADDRESS);

	if (s1_info_copied) {
		zassert_not_equal(CONFIG_FW_INFO_VALID_VAL,
			s1_info_copied->valid, "Failed to invalidate S1.\r\n");
		zassert_equal((u32_t)s1_info_copied, PM_S1_ADDRESS,
			"S1 info found at wrong address.\r\n");
		u32_t ret = nrfx_nvmc_page_erase(PM_S1_ADDRESS);

		zassert_equal(NRFX_SUCCESS, ret, "Erase failed.\r\n");
	} else {
		for (u32_t erase_addr = new_addr;
			erase_addr < (new_addr + copy_len);
			erase_addr += DT_PROP(DT_CHOSEN(zephyr_flash),
							erase_block_size)) {
			u32_t ret = nrfx_nvmc_page_erase(new_addr);

			zassert_equal(NRFX_SUCCESS, ret, "Erase failed.\r\n");
		}
		nrfx_nvmc_words_write(new_addr, (const u32_t *)PM_ADDRESS,
			(copy_len + 3) / 4);

		nrfx_nvmc_words_write(PM_S1_ADDRESS, &s1_info,
			(sizeof(s1_info) + 3) / 4);

		zassert_mem_equal(&s1_info, (void *)PM_S1_ADDRESS,
			sizeof(s1_info), "Failed to copy S1 info.\r\n");

		s1_info_copied = fw_info_find(PM_S1_ADDRESS);
		zassert_equal((u32_t)s1_info_copied, PM_S1_ADDRESS,
			"S1 info wrongly copied.\r\n");

		memcpy(val_info_buf, (const u32_t *)(PM_ADDRESS + copy_len),
			0x1000);

		struct __packed {
			u32_t magic[MAGIC_LEN_WORDS];
			u32_t address;
		} *val_info = (void *)(val_info_buf);

		const u32_t validation_info_magic[] = {VALIDATION_INFO_MAGIC};

		zassert_mem_equal(validation_info_magic, val_info->magic,
			MAGIC_LEN_WORDS*4,
			"Could not find validation info.\r\n");

		val_info->address = s1_info.address;
		nrfx_nvmc_words_write(s1_info.address + s1_info.size, val_info,
			0x1000);

		printk("Rebooting. Should fail to validate slot 1.\n");
		sys_reboot(0);
		zassert_true(false, "should not come here.");
	}
}


void test_validation_neg2(void)
{
#if PM_PROVISION_ADDRESS > 0xF00000
	u32_t num_public_keys = num_public_keys_read();
	bool any_valid = false;

	__aligned(4) u8_t key_data[CONFIG_SB_PUBLIC_KEY_HASH_LEN];

	for (u32_t key_data_idx = 0; key_data_idx < num_public_keys;
			key_data_idx++) {
		int retval = public_key_data_read(key_data_idx,
				key_data, CONFIG_SB_PUBLIC_KEY_HASH_LEN);
		if (retval != -EINVAL) {
			zassert_equal(CONFIG_SB_PUBLIC_KEY_HASH_LEN, retval,
				"Unexpected public key error, %d.", retval);
			invalidate_public_key(key_data_idx);
			any_valid = true;
		}
	}
	zassert_true(any_valid,
		"All public keys invalidated, should not have booted!");
	printk("Rebooting. Should fail to validate because of invalid public "
		"keys.\n");
	sys_reboot(0);
	zassert_true(false, "should not come here.");
#endif
}


void test_main(void)
{
	ztest_test_suite(test_bl_validation_neg,
			 ztest_unit_test(test_validation_neg1),
			 ztest_unit_test(test_validation_neg2)
	);
	ztest_run_test_suite(test_bl_validation_neg);
}
```
