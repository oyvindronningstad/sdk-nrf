## prj.conf
```kconfig
#
# Copyright (c) 2018 Nordic Semiconductor ASA
#
# SPDX-License-Identifier: LicenseRef-BSD-5-Clause-Nordic
#

CONFIG_ZTEST=y
CONFIG_SECURE_BOOT=y
CONFIG_SB_PUBLIC_KEY_FILES="ff_pub.pem"
CONFIG_FW_INFO=y
```

## src/main.c
```c
/*
 * Copyright (c) 2018 Nordic Semiconductor ASA
 *
 * SPDX-License-Identifier: LicenseRef-BSD-5-Clause-Nordic
 */

#include <ztest.h>

void test_ff_key(void)
{
	zassert_true(false, "Should not have booted.");
}

void test_main(void)
{
	ztest_test_suite(test_bl_crypto_ff_key,
			 ztest_unit_test(test_ff_key)
	);
	ztest_run_test_suite(test_bl_crypto_ff_key);
}
```
